## conf/layer.conf
```bitbake
# We have a conf and classes directory, append to BBPATH
BBPATH .= ":${LAYERDIR}"

# We have a recipes directory, add to BBFILES
BBFILES += "${LAYERDIR}/common/recipes-*/*/*.bb \
	${LAYERDIR}/common/recipes-*/*/*.bbappend"

BBFILE_COLLECTIONS += "renesas-proprietary"
BBFILE_PATTERN_renesas-proprietary := "^${LAYERDIR}/"
BBFILE_PRIORITY_renesas-proprietary = "5"
```

## meta-rcar-gen2-proprietary/conf/layer.conf
```bitbake
# We have a conf and classes directory, append to BBPATH
BBPATH .= ":${LAYERDIR}"

# We have a recipes directory, add to BBFILES
BBFILES += "${LAYERDIR}/recipes*/*/*.bb \
			${LAYERDIR}/recipes*/*/*.bbappend"

BBFILE_COLLECTIONS += "rcar-gen2-proprietary"
BBFILE_PATTERN_rcar-gen2-proprietary := "^${LAYERDIR}/"
BBFILE_PRIORITY_rcar-gen2-proprietary = "7"
```
